## buildroot/configs/canlogger_rpi3_defconfig
```kconfig
# CAN logger for Raspberry Pi 3 B / 3 B+ (64-bit). Based on Buildroot's raspberrypi3_64_defconfig.
BR2_aarch64=y
BR2_cortex_a53=y
BR2_ARM_FPU_VFPV4=y
BR2_TOOLCHAIN_EXTERNAL=y
# Arm GNU toolchain: prebuilt for both x86_64 and aarch64 build hosts
BR2_TOOLCHAIN_EXTERNAL_ARM_AARCH64=y
BR2_GLOBAL_PATCH_DIR="board/raspberrypi/patches"
BR2_DOWNLOAD_FORCE_CHECK_HASHES=y

# build speed: packages build in parallel (top-level make -jN), compiler cache.
# scripts/build-image.sh points BR2_DL_DIR / BR2_CCACHE_DIR at a shared cache.
BR2_PER_PACKAGE_DIRECTORIES=y
BR2_CCACHE=y

# system: BusyBox init, mdev, read-only root, our own inittab
BR2_TARGET_GENERIC_HOSTNAME="canlogger"
BR2_TARGET_GENERIC_ISSUE="CAN logger"
BR2_ROOTFS_DEVICE_CREATION_DYNAMIC_MDEV=y
# BR2_TARGET_GENERIC_REMOUNT_ROOTFS_RW is not set
# BR2_TARGET_GENERIC_GETTY is not set
BR2_SYSTEM_DHCP=""
BR2_ROOTFS_OVERLAY="$(BR2_EXTERNAL_CANLOGGER_PATH)/board/canlogger/rootfs_overlay"
BR2_ROOTFS_POST_BUILD_SCRIPT="$(BR2_EXTERNAL_CANLOGGER_PATH)/board/canlogger/post-build.sh"
BR2_ROOTFS_POST_IMAGE_SCRIPT="$(BR2_EXTERNAL_CANLOGGER_PATH)/board/canlogger/post-image.sh"

# kernel: Raspberry Pi fork, CAN drivers built in
BR2_LINUX_KERNEL=y
BR2_LINUX_KERNEL_CUSTOM_TARBALL=y
BR2_LINUX_KERNEL_CUSTOM_TARBALL_LOCATION="$(call github,raspberrypi,linux,21b410140c47ffab5668399f6f143c7d7b935c8b)/linux-21b410140c47ffab5668399f6f143c7d7b935c8b.tar.gz"
BR2_LINUX_KERNEL_DEFCONFIG="bcm2711"
BR2_LINUX_KERNEL_CONFIG_FRAGMENT_FILES="$(BR2_EXTERNAL_CANLOGGER_PATH)/board/canlogger/linux.fragment"
BR2_LINUX_KERNEL_DTS_SUPPORT=y
BR2_LINUX_KERNEL_INTREE_DTS_NAME="broadcom/bcm2710-rpi-3-b broadcom/bcm2710-rpi-3-b-plus"
BR2_LINUX_KERNEL_NEEDS_HOST_OPENSSL=y

# firmware + boot partition files
BR2_PACKAGE_RPI_FIRMWARE=y
BR2_PACKAGE_RPI_FIRMWARE_BOOTCODE_BIN=y
BR2_PACKAGE_RPI_FIRMWARE_VARIANT_PI_CD=y
BR2_PACKAGE_RPI_FIRMWARE_CONFIG_FILE="$(BR2_EXTERNAL_CANLOGGER_PATH)/board/canlogger/config.txt"
BR2_PACKAGE_RPI_FIRMWARE_CMDLINE_FILE="$(BR2_EXTERNAL_CANLOGGER_PATH)/board/canlogger/cmdline.txt"
BR2_PACKAGE_RPI_FIRMWARE_INSTALL_DTB_OVERLAYS=y
BR2_PACKAGE_RPI_FIRMWARE_EXTRA_FILES="$(BR2_EXTERNAL_CANLOGGER_PATH)/board/canlogger/logger.conf"
BR2_PACKAGE_BRCMFMAC_SDIO_FIRMWARE_RPI=y
BR2_PACKAGE_BRCMFMAC_SDIO_FIRMWARE_RPI_BT=y
BR2_PACKAGE_BRCMFMAC_SDIO_FIRMWARE_RPI_WIFI=y

# userland
BR2_PACKAGE_BUSYBOX_CONFIG_FRAGMENT_FILES="$(BR2_EXTERNAL_CANLOGGER_PATH)/board/canlogger/busybox.fragment"
BR2_PACKAGE_BUSYBOX_SHOW_OTHERS=y
BR2_PACKAGE_KMOD=y
BR2_PACKAGE_KMOD_TOOLS=y
BR2_PACKAGE_XZ=y
BR2_PACKAGE_IPROUTE2=y
BR2_PACKAGE_CAN_UTILS=y
BR2_PACKAGE_UTIL_LINUX=y
BR2_PACKAGE_UTIL_LINUX_BINARIES=y
BR2_PACKAGE_UTIL_LINUX_PARTX=y
BR2_PACKAGE_HOSTAPD=y
BR2_PACKAGE_HOSTAPD_DRIVER_NL80211=y
BR2_PACKAGE_DNSMASQ=y
# BR2_PACKAGE_DNSMASQ_TFTP is not set
BR2_PACKAGE_DBUS=y
BR2_PACKAGE_BLUEZ5_UTILS=y
BR2_PACKAGE_DROPBEAR=y
BR2_PACKAGE_HOST_RUSTC=y
BR2_PACKAGE_CANLOGGER=y
BR2_PACKAGE_CANLOGGER_BLE=y

# images
BR2_TARGET_ROOTFS_EXT2=y
BR2_TARGET_ROOTFS_EXT2_4=y
BR2_TARGET_ROOTFS_EXT2_SIZE="160M"
# BR2_TARGET_ROOTFS_TAR is not set
BR2_PACKAGE_HOST_DOSFSTOOLS=y
BR2_PACKAGE_HOST_GENIMAGE=y
BR2_PACKAGE_HOST_KMOD_XZ=y
BR2_PACKAGE_HOST_MTOOLS=y
```

## buildroot/package/canlogger/Config.in
```kconfig
config BR2_PACKAGE_CANLOGGER
	bool "canlogger"
	depends on BR2_PACKAGE_HOST_RUSTC_TARGET_ARCH_SUPPORTS
	select BR2_PACKAGE_HOST_RUSTC
	select BR2_PACKAGE_IPROUTE2 # "ip link set ... type can"
	help
	  CAN bus logger: canlogd (writes every frame from every
	  SocketCAN interface to a raw ring partition), canweb (HTTP
	  status page and downloads), canring (command line reader).

if BR2_PACKAGE_CANLOGGER

config BR2_PACKAGE_CANLOGGER_BLE
	bool "Bluetooth LE service (canble)"
	default y
	depends on BR2_PACKAGE_BLUEZ5_UTILS
	select BR2_PACKAGE_DBUS
	help
	  GATT service for status, live data, time sync and commands
	  from a phone (Web Bluetooth).

comment "canble needs bluez5_utils"
	depends on !BR2_PACKAGE_BLUEZ5_UTILS

endif
```
